## config/west.yml
```yaml
manifest:
  remotes:
    - name: zmkfirmware
      url-base: https://github.com/fts/
  projects:
    - name: zmk
      remote: zmkfirmware
      revision: mouse-ftc
      import: app/west.yml
  self:
    path: config
```
